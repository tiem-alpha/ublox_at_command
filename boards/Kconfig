## boards/Kconfig
```kconfig
# Copyright (c) 2023 Nordic Semiconductor ASA
# SPDX-License-Identifier: Apache-2.0

config BOARD_ROOT
	string "Custom board root"
	depends on !BOARD_USER_CUSTOM_NET_IF_OFFLOAD_L2

source "boards/arm/Kconfig"
```

## boards/arm/Kconfig
```kconfig
# Copyright (c) 2023 Nordic Semiconductor ASA
# SPDX-License-Identifier: Apache-2.0

source "boards/arm/spyder_nrf52840/Kconfig.board"
```

## boards/arm/spyder_nrf52840/Kconfig.board
```kconfig
# Copyright (c) 2023 Nordic Semiconductor ASA
# SPDX-License-Identifier: Apache-2.0

config BOARD_SPYDER_NRF52840
	bool "Spyder NRF52840"
	depends on SOC_NRF52840_QIAA
```

## boards/arm/spyder_nrf52840/Kconfig.defconfig
```kconfig
# Copyright (c) 2023 Nordic Semiconductor ASA
# SPDX-License-Identifier: Apache-2.0

if BOARD_SPYDER_NRF52840

config BOARD
	default "spyder_nrf52840"

endif # BOARD_SPYDER_NRF52840
```

## boards/arm/spyder_nrf52840/Kconfig.spyder_nrf52840
```kconfig
# Copyright (c) 2023 Nordic Semiconductor ASA
# SPDX-License-Identifier: Apache-2.0

config BOARD_SPYDER_NRF52840
	select SOC_NRF52840_QIAA
```

## boards/arm/spyder_nrf52840/board.yml
```yaml
board:
  name: spyder_nrf52840
  full_name: Spyder NRF52840
  vendor: others
  socs:
  - name: nrf52840
```

## boards/arm/spyder_nrf52840/spyder_nrf52840_nrf52840_defconfig
```kconfig
# Copyright (c) 2023 Nordic Semiconductor ASA
# SPDX-License-Identifier: Apache-2.0

# Enable MPU
CONFIG_ARM_MPU=y

# Enable hardware stack protection
CONFIG_HW_STACK_PROTECTION=y

# enable GPIO
CONFIG_GPIO=y
CONFIG_PINCTRL=y

# enable uart driver
CONFIG_SERIAL=y
```
